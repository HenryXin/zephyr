## boards/friendlyarm/nanopi_neo/board.yml
```yaml
board:
  name: nanopi_neo
  full_name: NanoPi NEO
  vendor: friendlyarm
  socs:
  - name: sun8i_h3
```

## boards/friendlyarm/nanopi_neo/nanopi_neo_defconfig
```kconfig
# Copyright The Zephyr Project Contributors
# SPDX-License-Identifier: Apache-2.0

# Serial Drivers
CONFIG_SERIAL=y

# Enable Console
CONFIG_CONSOLE=y
CONFIG_UART_CONSOLE=y
```

## boards/lilygo/ttgo_t_higrow/Kconfig
```kconfig
# Copyright The Zephyr Project Contributors
# SPDX-License-Identifier: Apache-2.0

config HEAP_MEM_POOL_ADD_SIZE_BOARD
	int
	default 4096 if BOARD_TTGO_T_HIGROW_ESP32_PROCPU
	default 256 if BOARD_TTGO_T_HIGROW_ESP32_APPCPU
```

## boards/lilygo/ttgo_t_higrow/Kconfig.ttgo_t_higrow
```kconfig
# Copyright The Zephyr Project Contributors
# SPDX-License-Identifier: Apache-2.0

config BOARD_TTGO_T_HIGROW
	select SOC_ESP32
	select SOC_ESP32_PROCPU if BOARD_TTGO_T_HIGROW_ESP32_PROCPU
	select SOC_ESP32_APPCPU if BOARD_TTGO_T_HIGROW_ESP32_APPCPU
```

## boards/lilygo/ttgo_t_higrow/board.yml
```yaml
board:
  name: ttgo_t_higrow
  full_name: TTGO T-Higrow (DHT11)
  vendor: lilygo
  socs:
  - name: esp32
```

## boards/renesas/fpb_ra2e2/Kconfig.fpb_ra2e2
```kconfig
# Copyright (c) 2026 Renesas Electronics Corporation
# SPDX-License-Identifier: Apache-2.0

config BOARD_FPB_RA2E2
	select SOC_R7FA2E2A72DNK
```

## boards/renesas/fpb_ra2e2/board.yml
```yaml
board:
  name: fpb_ra2e2
  full_name: RA2E2 Fast Prototyping Board
  vendor: renesas
  socs:
  - name: r7fa2e2a72dnk
```

## boards/renesas/fpb_ra2e2/fpb_ra2e2_defconfig
```kconfig
# Copyright (c) 2026 Renesas Electronics Corporation
# SPDX-License-Identifier: Apache-2.0

CONFIG_GPIO=y
CONFIG_SERIAL=y
CONFIG_UART_INTERRUPT_DRIVEN=y
CONFIG_UART_CONSOLE=y
CONFIG_CONSOLE=y
```

## boards/shields/weact_ov2640_cam_module/boards/weact_stm32h723_core.conf
```kconfig
# SPDX-FileCopyrightText: Copyright The Zephyr Project Contributors
# SPDX-License-Identifier: Apache-2.0

CONFIG_VIDEO_HFLIP=y
CONFIG_VIDEO_VFLIP=y
```

## boards/st/steval_stwinkt1b/Kconfig.defconfig
```kconfig
# STEVAL_STWINKT1B Development kit board configuration

# Copyright The Zephyr Project Contributors
# SPDX-License-Identifier: Apache-2.0

if BOARD_STEVAL_STWINKT1B

if BT

config BT_BLUENRG_ACI
	default y

# Disable Flow control
config BT_HCI_ACL_FLOW_CONTROL
	default n

config BT_HCI_VS
	default n

endif # BT

source "boards/common/usb/Kconfig.cdc_acm_serial.defconfig"

endif # BOARD_STEVAL_STWINKT1B
```

## boards/st/steval_stwinkt1b/Kconfig.steval_stwinkt1b
```kconfig
# Copyright The Zephyr Project Contributors
# SPDX-License-Identifier: Apache-2.0

config BOARD_STEVAL_STWINKT1B
	select SOC_STM32L4R9XX
```

## boards/weact/bluepillplus_gd32f303cc/Kconfig.bluepillplus_gd32f303cc
```kconfig
# Copyright The Zephyr Project Contributors
# SPDX-License-Identifier: Apache-2.0

config BOARD_BLUEPILLPLUS_GD32F303CC
	select SOC_GD32F403
```

## boards/weact/bluepillplus_gd32f303cc/board.yml
```yaml
board:
  name: bluepillplus_gd32f303cc
  full_name: BluePill Plus GD32F303CCT6
  vendor: weact
  socs:
    - name: gd32f403
```

## boards/weact/stm32h723_core/Kconfig.weact_stm32h723_core
```kconfig
# SPDX-FileCopyrightText: Copyright The Zephyr Project Contributors
# SPDX-License-Identifier: Apache-2.0

config BOARD_WEACT_STM32H723_CORE
	select SOC_STM32H723XX
```

## boards/weact/stm32h723_core/board.yml
```yaml
board:
  name: weact_stm32h723_core
  full_name: STM32H723 Core Board
  vendor: weact
  socs:
    - name: stm32h723xx
```

## soc/renesas/ra/ra2e2/Kconfig
```kconfig
# Copyright (c) 2026 Renesas Electronics Corporation
# SPDX-License-Identifier: Apache-2.0

config SOC_SERIES_RA2E2
	select ARM
	select CPU_CORTEX_M23
	select CPU_HAS_ARM_MPU
	select HAS_RENESAS_RA_FSP
	select CPU_CORTEX_M_HAS_VTOR
	select CPU_CORTEX_M_HAS_SYSTICK
	select CLOCK_CONTROL_RENESAS_RA_CGC if CLOCK_CONTROL
	select HAS_SWO
	select SOC_RA_DYNAMIC_INTERRUPT_NUMBER

if SOC_SERIES_RA2E2

config RENESAS_PN_PACKAGE_TYPE
	int
	range 1 3
	default 1 if SOC_R7FA2E2A72DNK
	help
	  Package type:
	  1 -> NK: HWQFN 24 pins
	  2 -> NJ: HWQFN 20 pins
	  3 -> BY: WLCSP 16 pins

endif # SOC_SERIES_RA2E2
```

## soc/renesas/ra/ra2e2/Kconfig.soc
```kconfig
# Copyright (c) 2026 Renesas Electronics Corporation
# SPDX-License-Identifier: Apache-2.0

config SOC_SERIES_RA2E2
	bool
	select SOC_FAMILY_RENESAS_RA

config SOC_R7FA2E2A72DNK
	bool
	select SOC_SERIES_RA2E2

config SOC_SERIES
	default "ra2e2" if SOC_SERIES_RA2E2

config SOC
	default "r7fa2e2a72dnk" if SOC_R7FA2E2A72DNK
```
