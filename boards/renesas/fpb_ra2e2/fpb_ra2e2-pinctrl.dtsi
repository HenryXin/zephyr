/*
 * Copyright (c) 2026 Renesas Electronics Corporation
 * SPDX-License-Identifier: Apache-2.0
 */

&pinctrl {
	/*
	 * SCI9 on Arduino D1/D0 and Pmod 2: P109 TXD9, P110 RXD9.
	 * High drive helps when the on-board E2 is also attached to these
	 * pins (UM E25/E26/E28/E29); see board.c UART settle delay.
	 */
	sci9_default: sci9_default {
		group1 {
			/* tx */
			psels = <RA_PSEL(RA_PSEL_SCI_9, 1, 9)>;
			drive-strength = "high";
		};
		group2 {
			/* rx */
			psels = <RA_PSEL(RA_PSEL_SCI_9, 1, 10)>;
			drive-strength = "high";
		};
	};
};
